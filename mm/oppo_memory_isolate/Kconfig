## mm/oppo_memory_isolate/Kconfig
```kconfig
# SPDX-License-Identifier: GPL-2.0-only
# Copyright (C) 2018-2020 Oplus. All rights reserved.

config OPPO_MEMORY_ISOLATE
       bool "Enable oppo memory isolate to anti fragment"
       depends on !CONFIG_VMAP_STACK
       default n
       help
        Isolate memory to anti fragment.
```
